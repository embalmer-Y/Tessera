## CMakeLists.txt
```
# SPDX-License-Identifier: Apache-2.0
cmake_minimum_required(VERSION 3.20.0)
find_package(Zephyr REQUIRED HINTS $ENV{ZEPHYR_BASE})
project(threadslang)

target_sources(app PRIVATE src/main.c)
```

## prj.conf
```kconfig
# SPDX-License-Identifier: Apache-2.0
# framework.threads（V2 纵深批 M19a，DEC-55/Q-37 A）：真 wasm 多线程
# sim 回归——宿主侧 spawn 编排全链（spawn/join/原子共享/cap 收口）。
CONFIG_ZTEST=y
CONFIG_TS_APP_WAMR=y
CONFIG_TS_TEST=y
CONFIG_TS_APP_THREADS=y
CONFIG_TS_APP_WAMR_HEAP=262144
```

## src/main.c
```c
/* SPDX-License-Identifier: Apache-2.0 */
/* framework.threads（V2 纵深批 M19a，DEC-55/Q-37 A）：真 wasm 多线程
 * sim 回归——宿主侧 spawn 编排全链。
 *   test_01 双线程 spawn/join/原子共享：threads=3 申报 → 并发 2 worker
 *           （共享线性内存原子累加）→ join 双返回值 + g_counter==3000
 *           → PASS 旗（gpio0）；
 *   test_02 未申报拒绝：不调 set_threads（threads_max<2）→ spawn 返回
 *           E_STATE → FAIL 旗（gpio1）——DEC-31 单线程语义 fail-closed；
 *   test_03 并发 cap：threads=2 → 第二并发 spawn E_RANGE → join 后槽
 *           复用重 spawn → 全量汇合 PASS 旗。 */
#include <string.h>
#include <zephyr/kernel.h>
#include <zephyr/ztest.h>
#include <ts/appmgr.h>
#include <ts/hal.h>
#include <ts/safety.h>
#include "thread_app_wasm.h"

static const ts_out_ch_t ch0 = {
	.uid = "th0", .kind = TS_CH_GPIO,
	.poweron = {.b = false}, .linkloss = {.b = false}, .fault = {.b = false},
};
static const ts_out_ch_t ch1 = {
	.uid = "th1", .kind = TS_CH_GPIO,
	.poweron = {.b = false}, .linkloss = {.b = false}, .fault = {.b = false},
};
static const ts_hal_dev_desc_t dev0 = {.uid = "th0", .kind = TS_DEV_GPIO_OUT};
static const ts_hal_dev_desc_t dev1 = {.uid = "th1", .kind = TS_DEV_GPIO_OUT};
static bool hal_done;

static bool gpio_val(int inst)
{
	ts_out_value_t v;
	char uid[8] = {'t', 'h', '0'};

	uid[2] = (char)('0' + inst);
	if (ts_safety_readback(uid, &v) != TS_OK) {
		return false;
	}
	return v.b;
}

static bool wait_gpio(int inst, bool want)
{
	for (int i = 0; i < 300; i++) {
		if (gpio_val(inst) == want) {
			return true;
		}
		k_msleep(10);
	}
	return false;
}

static void suite_setup(void)
{
	ts_safety_test_reset();
	ts_appmgr_app_test_reset();
	if (!hal_done) { /* hal 注册表进程级共享——一次即可 */
		zassert_equal(ts_hal_register_dev(&dev0), TS_OK);
		zassert_equal(ts_hal_register_dev(&dev1), TS_OK);
		hal_done = true;
	}
	zassert_equal(ts_safety_register_channel(&ch0), TS_OK);
	zassert_equal(ts_safety_register_channel(&ch1), TS_OK);
	ts_safety_set_link(true);
}

ZTEST(framework_threads, test_01_spawn_join_atomic)
{
	suite_setup();
	ts_appmgr_app_set_threads(1, 3);
	zassert_equal(ts_appmgr_app_start(1, thread_app_wasm, thread_app_wasm_len,
					  "gpio:write:0-1"), TS_OK);
	zassert_true(wait_gpio(0, true),
		     "双 worker 原子累加 3000 + join 返回值校验 → PASS 旗");
	zassert_false(gpio_val(1), "FAIL 旗未起");
	struct ts_app_rt_stats st;

	ts_appmgr_app_stats(&st);
	zassert_equal(st.health_fails, 0, "健康无失败（worker 异常会计入）");
	zassert_equal(ts_appmgr_app_stop(), TS_OK);
}

ZTEST(framework_threads, test_02_undeclared_reject)
{
	suite_setup();
	/* 不调 set_threads（threads_max=0<2）——spawn 必须 E_STATE 拒绝 */
	zassert_equal(ts_appmgr_app_start(1, thread_app_wasm, thread_app_wasm_len,
					  "gpio:write:0-1"), TS_OK);
	zassert_true(wait_gpio(1, true), "未申报 threads → spawn 拒绝 → FAIL 旗");
	zassert_false(gpio_val(0), "PASS 旗未起");
	zassert_equal(ts_appmgr_app_stop(), TS_OK);
}

ZTEST(framework_threads, test_03_concurrency_cap)
{
	suite_setup();
	ts_appmgr_app_set_threads(1, 2); /* 并发 worker 上限 = 1 */
	zassert_equal(ts_appmgr_app_start(1, thread_app_wasm, thread_app_wasm_len,
					  "gpio:write:0-1"), TS_OK);
	zassert_true(wait_gpio(0, true),
		     "cap 拒绝 → join 后槽复用重 spawn → 全量汇合 PASS 旗");
	zassert_false(gpio_val(1), "FAIL 旗未起");
	zassert_equal(ts_appmgr_app_stop(), TS_OK);
}

ZTEST_SUITE(framework_threads, NULL, NULL, NULL, NULL, NULL);
```

## src/thread_app_wasm.h
```c
unsigned char thread_app_wasm[] = {
  0x00, 0x61, 0x73, 0x6d, 0x01, 0x00, 0x00, 0x00, 0x01, 0x22, 0x06, 0x60,
  0x04, 0x7f, 0x7f, 0x7f, 0x7f, 0x01, 0x7f, 0x60, 0x03, 0x7f, 0x7f, 0x7f,
  0x01, 0x7f, 0x60, 0x02, 0x7f, 0x7f, 0x01, 0x7f, 0x60, 0x00, 0x00, 0x60,
  0x00, 0x01, 0x7f, 0x60, 0x01, 0x7f, 0x01, 0x7f, 0x02, 0x53, 0x04, 0x03,
  0x65, 0x6e, 0x76, 0x0f, 0x74, 0x73, 0x5f, 0x74, 0x68, 0x72, 0x65, 0x61,
  0x64, 0x5f, 0x73, 0x74, 0x61, 0x72, 0x74, 0x00, 0x00, 0x03, 0x65, 0x6e,
  0x76, 0x0c, 0x74, 0x73, 0x5f, 0x6c, 0x6f, 0x67, 0x5f, 0x77, 0x72, 0x69,
  0x74, 0x65, 0x00, 0x00, 0x03, 0x65, 0x6e, 0x76, 0x0d, 0x74, 0x73, 0x5f,
  0x67, 0x70, 0x69, 0x6f, 0x5f, 0x77, 0x72, 0x69, 0x74, 0x65, 0x00, 0x01,
  0x03, 0x65, 0x6e, 0x76, 0x0e, 0x74, 0x73, 0x5f, 0x74, 0x68, 0x72, 0x65,
  0x61, 0x64, 0x5f, 0x6a, 0x6f, 0x69, 0x6e, 0x00, 0x02, 0x03, 0x06, 0x05,
  0x03, 0x04, 0x05, 0x05, 0x04, 0x05, 0x04, 0x01, 0x03, 0x01, 0x02, 0x06,
  0x1a, 0x04, 0x7f, 0x01, 0x41, 0xc0, 0x88, 0x02, 0x0b, 0x7f, 0x01, 0x41,
  0x00, 0x0b, 0x7f, 0x00, 0x41, 0xc0, 0x08, 0x0b, 0x7f, 0x00, 0x41, 0xc0,
  0x88, 0x02, 0x0b, 0x07, 0x52, 0x07, 0x06, 0x6d, 0x65, 0x6d, 0x6f, 0x72,
  0x79, 0x02, 0x00, 0x0b, 0x68, 0x65, 0x61, 0x6c, 0x74, 0x68, 0x5f, 0x70,
  0x69, 0x6e, 0x67, 0x00, 0x05, 0x08, 0x61, 0x70, 0x70, 0x5f, 0x69, 0x6e,
  0x69, 0x74, 0x00, 0x06, 0x06, 0x77, 0x6f, 0x72, 0x6b, 0x65, 0x72, 0x00,
  0x07, 0x08, 0x61, 0x70, 0x70, 0x5f, 0x74, 0x69, 0x63, 0x6b, 0x00, 0x08,
  0x0a, 0x5f, 0x5f, 0x64, 0x61, 0x74, 0x61, 0x5f, 0x65, 0x6e, 0x64, 0x03,
  0x02, 0x0b, 0x5f, 0x5f, 0x68, 0x65, 0x61, 0x70, 0x5f, 0x62, 0x61, 0x73,
  0x65, 0x03, 0x03, 0x08, 0x01, 0x04, 0x0c, 0x01, 0x01, 0x0a, 0xa2, 0x06,
  0x05, 0x54, 0x00, 0x02, 0x40, 0x02, 0x40, 0x02, 0x40, 0x41, 0xbc, 0x08,
  0x41, 0x00, 0x41, 0x01, 0xfe, 0x48, 0x02, 0x00, 0x0e, 0x02, 0x00, 0x01,
  0x02, 0x0b, 0x41, 0x80, 0x08, 0x41, 0x00, 0x41, 0x1d, 0xfc, 0x08, 0x00,
  0x00, 0x41, 0xa0, 0x08, 0x41, 0x00, 0x41, 0x19, 0xfc, 0x0b, 0x00, 0x41,
  0xbc, 0x08, 0x41, 0x02, 0xfe, 0x17, 0x02, 0x00, 0x41, 0xbc, 0x08, 0x41,
  0x7f, 0xfe, 0x00, 0x02, 0x00, 0x1a, 0x0c, 0x01, 0x0b, 0x41, 0xbc, 0x08,
  0x41, 0x01, 0x42, 0x7f, 0xfe, 0x01, 0x02, 0x00, 0x1a, 0x0b, 0xfc, 0x09,
  0x00, 0x0b, 0x04, 0x00, 0x41, 0x00, 0x0b, 0x51, 0x00, 0x41, 0x00, 0x41,
  0x00, 0x36, 0x02, 0xa4, 0x88, 0x80, 0x80, 0x00, 0x41, 0x00, 0x41, 0x00,
  0x36, 0x02, 0xa0, 0x88, 0x80, 0x80, 0x00, 0x41, 0x00, 0x41, 0x00, 0x36,
  0x02, 0xa8, 0x88, 0x80, 0x80, 0x00, 0x41, 0x00, 0x41, 0x00, 0x36, 0x02,
  0xac, 0x88, 0x80, 0x80, 0x00, 0x41, 0x00, 0x41, 0x00, 0x36, 0x02, 0xb0,
  0x88, 0x80, 0x80, 0x00, 0x41, 0x00, 0x41, 0x00, 0x36, 0x02, 0xb4, 0x88,
  0x80, 0x80, 0x00, 0x41, 0x00, 0x41, 0x00, 0x3a, 0x00, 0xb8, 0x88, 0x80,
  0x80, 0x00, 0x41, 0x00, 0x0b, 0xbe, 0x01, 0x01, 0x02, 0x7f, 0x02, 0x40,
  0x20, 0x00, 0x41, 0x01, 0x48, 0x0d, 0x00, 0x20, 0x00, 0x41, 0x07, 0x71,
  0x21, 0x01, 0x02, 0x40, 0x20, 0x00, 0x41, 0x08, 0x49, 0x0d, 0x00, 0x20,
  0x00, 0x41, 0xf8, 0xff, 0xff, 0xff, 0x07, 0x71, 0x21, 0x02, 0x03, 0x40,
  0x41, 0x00, 0x41, 0x01, 0xfe, 0x1e, 0x02, 0xa0, 0x88, 0x80, 0x80, 0x00,
  0x1a, 0x41, 0x00, 0x41, 0x01, 0xfe, 0x1e, 0x02, 0xa0, 0x88, 0x80, 0x80,
  0x00, 0x1a, 0x41, 0x00, 0x41, 0x01, 0xfe, 0x1e, 0x02, 0xa0, 0x88, 0x80,
  0x80, 0x00, 0x1a, 0x41, 0x00, 0x41, 0x01, 0xfe, 0x1e, 0x02, 0xa0, 0x88,
  0x80, 0x80, 0x00, 0x1a, 0x41, 0x00, 0x41, 0x01, 0xfe, 0x1e, 0x02, 0xa0,
  0x88, 0x80, 0x80, 0x00, 0x1a, 0x41, 0x00, 0x41, 0x01, 0xfe, 0x1e, 0x02,
  0xa0, 0x88, 0x80, 0x80, 0x00, 0x1a, 0x41, 0x00, 0x41, 0x01, 0xfe, 0x1e,
  0x02, 0xa0, 0x88, 0x80, 0x80, 0x00, 0x1a, 0x41, 0x00, 0x41, 0x01, 0xfe,
  0x1e, 0x02, 0xa0, 0x88, 0x80, 0x80, 0x00, 0x1a, 0x20, 0x02, 0x41, 0x78,
  0x6a, 0x22, 0x02, 0x0d, 0x00, 0x0b, 0x0b, 0x20, 0x01, 0x45, 0x0d, 0x00,
  0x03, 0x40, 0x41, 0x00, 0x41, 0x01, 0xfe, 0x1e, 0x02, 0xa0, 0x88, 0x80,
  0x80, 0x00, 0x1a, 0x20, 0x01, 0x41, 0x7f, 0x6a, 0x22, 0x01, 0x0d, 0x00,
  0x0b, 0x0b, 0x20, 0x00, 0x0b, 0xb3, 0x03, 0x01, 0x01, 0x7f, 0x02, 0x40,
  0x02, 0x40, 0x02, 0x40, 0x02, 0x40, 0x02, 0x40, 0x41, 0x00, 0x28, 0x02,
  0xa4, 0x88, 0x80, 0x80, 0x00, 0x0e, 0x04, 0x00, 0x01, 0x02, 0x03, 0x04,
  0x0b, 0x41, 0x00, 0x41, 0x00, 0x41, 0x80, 0x88, 0x80, 0x80, 0x00, 0x41,
  0x06, 0x41, 0xe8, 0x07, 0x10, 0x80, 0x80, 0x80, 0x80, 0x00, 0x22, 0x00,
  0x36, 0x02, 0xac, 0x88, 0x80, 0x80, 0x00, 0x02, 0x40, 0x20, 0x00, 0x41,
  0x7f, 0x4a, 0x0d, 0x00, 0x41, 0x00, 0x41, 0x03, 0x41, 0x87, 0x88, 0x80,
  0x80, 0x00, 0x41, 0x15, 0x10, 0x81, 0x80, 0x80, 0x80, 0x00, 0x1a, 0x41,
  0x00, 0x41, 0x01, 0x41, 0x01, 0x10, 0x82, 0x80, 0x80, 0x80, 0x00, 0x1a,
  0x41, 0x00, 0x41, 0x04, 0x36, 0x02, 0xa4, 0x88, 0x80, 0x80, 0x00, 0x41,
  0x00, 0x0f, 0x0b, 0x41, 0x00, 0x41, 0x00, 0x41, 0x80, 0x88, 0x80, 0x80,
  0x00, 0x41, 0x06, 0x41, 0xd0, 0x0f, 0x10, 0x80, 0x80, 0x80, 0x80, 0x00,
  0x22, 0x00, 0x36, 0x02, 0xa8, 0x88, 0x80, 0x80, 0x00, 0x02, 0x40, 0x20,
  0x00, 0x41, 0x7f, 0x4a, 0x0d, 0x00, 0x41, 0x00, 0x41, 0x01, 0x3a, 0x00,
  0xb8, 0x88, 0x80, 0x80, 0x00, 0x0b, 0x41, 0x00, 0x41, 0x01, 0x36, 0x02,
  0xa4, 0x88, 0x80, 0x80, 0x00, 0x41, 0x00, 0x0f, 0x0b, 0x41, 0x00, 0x41,
  0x00, 0x28, 0x02, 0xac, 0x88, 0x80, 0x80, 0x00, 0x10, 0x83, 0x80, 0x80,
  0x80, 0x00, 0x21, 0x00, 0x41, 0x00, 0x41, 0x02, 0x36, 0x02, 0xa4, 0x88,
  0x80, 0x80, 0x00, 0x41, 0x00, 0x20, 0x00, 0x36, 0x02, 0xb4, 0x88, 0x80,
  0x80, 0x00, 0x41, 0x00, 0x0f, 0x0b, 0x02, 0x40, 0x41, 0x00, 0x2d, 0x00,
  0xb8, 0x88, 0x80, 0x80, 0x00, 0x45, 0x0d, 0x00, 0x41, 0x00, 0x41, 0x00,
  0x41, 0x80, 0x88, 0x80, 0x80, 0x00, 0x41, 0x06, 0x41, 0xd0, 0x0f, 0x10,
  0x80, 0x80, 0x80, 0x80, 0x00, 0x22, 0x00, 0x36, 0x02, 0xa8, 0x88, 0x80,
  0x80, 0x00, 0x02, 0x40, 0x20, 0x00, 0x41, 0x7f, 0x4a, 0x0d, 0x00, 0x41,
  0x00, 0x41, 0x01, 0x41, 0x01, 0x10, 0x82, 0x80, 0x80, 0x80, 0x00, 0x1a,
  0x41, 0x00, 0x41, 0x04, 0x36, 0x02, 0xa4, 0x88, 0x80, 0x80, 0x00, 0x41,
  0x00, 0x0f, 0x0b, 0x41, 0x00, 0x41, 0x00, 0x3a, 0x00, 0xb8, 0x88, 0x80,
  0x80, 0x00, 0x41, 0x00, 0x0f, 0x0b, 0x41, 0x00, 0x41, 0x00, 0x28, 0x02,
  0xa8, 0x88, 0x80, 0x80, 0x00, 0x10, 0x83, 0x80, 0x80, 0x80, 0x00, 0x21,
  0x00, 0x41, 0x00, 0x41, 0x03, 0x36, 0x02, 0xa4, 0x88, 0x80, 0x80, 0x00,
  0x41, 0x00, 0x20, 0x00, 0x36, 0x02, 0xb0, 0x88, 0x80, 0x80, 0x00, 0x41,
  0x00, 0x0f, 0x0b, 0x41, 0x00, 0x41, 0x00, 0x41, 0x00, 0x28, 0x02, 0xa0,
  0x88, 0x80, 0x80, 0x00, 0x41, 0xb8, 0x17, 0x46, 0x41, 0x00, 0x28, 0x02,
  0xb4, 0x88, 0x80, 0x80, 0x00, 0x41, 0xe8, 0x07, 0x46, 0x71, 0x41, 0x00,
  0x28, 0x02, 0xb0, 0x88, 0x80, 0x80, 0x00, 0x41, 0xd0, 0x0f, 0x46, 0x71,
  0x10, 0x82, 0x80, 0x80, 0x80, 0x00, 0x1a, 0x41, 0x00, 0x41, 0x04, 0x36,
  0x02, 0xa4, 0x88, 0x80, 0x80, 0x00, 0x0b, 0x41, 0x00, 0x0b, 0x0b, 0x20,
  0x01, 0x01, 0x1d, 0x77, 0x6f, 0x72, 0x6b, 0x65, 0x72, 0x00, 0x74, 0x68,
  0x72, 0x64, 0x20, 0x73, 0x70, 0x61, 0x77, 0x6e, 0x31, 0x20, 0x72, 0x65,
  0x6a, 0x65, 0x63, 0x74, 0x65, 0x64, 0x0a, 0x00
};
unsigned int thread_app_wasm_len = 1100;
```
