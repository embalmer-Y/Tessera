## CMakeLists.txt
```
# SPDX-License-Identifier: Apache-2.0
cmake_minimum_required(VERSION 3.20.0)
find_package(Zephyr REQUIRED HINTS $ENV{ZEPHYR_BASE})
project(tessera_p4psram)

target_sources(app PRIVATE src/main.c)
```

## prj.conf
```kconfig
# SPDX-License-Identifier: Apache-2.0
# p4psram（P4 PSRAM 批）：psrambench 源级复用——P4 PSRAM（16 线 HEX，
# 32MB）挂接 + WAMR 实例堆入 PSRAM（DEC-27 分层纪律）。直启面。
CONFIG_PRINTK=y
CONFIG_TS_CORE=y
CONFIG_TS_SAFETY=y
CONFIG_TS_APP_WAMR=y
# 本基准无网面/无持久化（板级四/五已测）
CONFIG_TS_NET=n
CONFIG_MAIN_THREAD_PRIORITY=15
```

## boards/esp32p4_wifi6_dev_kit_esp32p4_hpcore.conf
```kconfig
# SPDX-License-Identifier: Apache-2.0
# P4 PSRAM 批板级片段（Waveshare ESP32-P4-WIFI6-DEV-KIT：32MB 16 线 PSRAM）。
# SPIRAM_MODE_HEX = P4 专属默认（16 线；S3 的 OCT/QUAD 不可用——Kconfig
# depends 已把守，显式声明自文档）。WAMR 堆 256KB = S3 板级六同值
# （DEC-27；P4 32MB 面下的更大值属内存预算批，不越权定）。
CONFIG_ESP_SPIRAM=y
CONFIG_SPIRAM_MODE_HEX=y
CONFIG_ESP_SPIRAM_MEMTEST=y
CONFIG_TS_APP_PSRAM_HEAP=y
CONFIG_TS_APP_WAMR_HEAP=262144
CONFIG_TS_STORE_SLOT_SIZE=32768
CONFIG_TS_APP_THREAD_STACK=16384
CONFIG_MAIN_STACK_SIZE=8192
```

## boards/esp32p4_wifi6_dev_kit_esp32p4_hpcore.overlay
```dts
/*
 * P4 PSRAM 批板级 overlay（Waveshare ESP32-P4-WIFI6-DEV-KIT HP 核）：
 * console 重指 uart0（CH343 COM 口单线判据——板默认 usb_serial 需另接
 * USB 口；p4bench 同型）。PSRAM 走板 dts 既有 &psram0（32MB）+ Kconfig
 * SPIRAM 面，overlay 无需分区工作。
 */
/ {
	chosen {
		zephyr,console = &uart0;
		zephyr,shell-uart = &uart0;
	};
};
```

## src/main.c
```c
/* SPDX-License-Identifier: Apache-2.0 */
/*
 * psrambench（板级六）：PSRAM 挂接验证（docs/board-psram.md）。
 * 流程：P4P1 SMH 探针（读写一致性 + 外部 RAM 地址域证据）→ P4P2 通道注册
 * + 链路声明（直启面，framework.app 同款）→ P4P3 APP 启动（WAMR 实例堆
 * 此时自 PSRAM 分配——runtime 打印池地址）→ evt 写路径全链 → PASS。
 */
#include <string.h>
#include <zephyr/kernel.h>
#include <zephyr/multi_heap/shared_multi_heap.h>
#include <ts/appmgr.h>
#include <ts/hal.h>
#include <ts/safety.h>
#include "app_wasm.h"

static const ts_out_ch_t ps_ch = {
	.uid = "ps0", .kind = TS_CH_GPIO,
	.poweron = {.b = false}, .linkloss = {.b = false}, .fault = {.b = false},
};
static const ts_hal_dev_desc_t ps_dev = {.uid = "ps0", .kind = TS_DEV_GPIO_OUT};

static bool ps_gpio(void)
{
	ts_out_value_t v;

	if (ts_safety_readback("ps0", &v) != TS_OK) {
		return false;
	}
	return v.b;
}

static bool ps_wait_gpio(bool want)
{
	for (int i = 0; i < 300; i++) {
		if (ps_gpio() == want) {
			return true;
		}
		k_msleep(10);
	}
	return false;
}

int main(void)
{
	printk("P4P0 psrambench\n");

	/* P4P1: SMH 探针——P4 外部 RAM 映射 0x48000000 起（EXTMEM 域；内部 HP SRAM 为
	 * 0x4ffxxxxx），指针值即位置证据。 */
	uint8_t *probe = shared_multi_heap_alloc(SMH_REG_ATTR_EXTERNAL, 256);

	if (probe == NULL) {
		printk("P4P FAIL smh alloc\n");
		return 1;
	}
	for (int i = 0; i < 256; i++) {
		probe[i] = (uint8_t)(0xA5 ^ i);
	}
	bool ok = true;

	for (int i = 0; i < 256; i++) {
		ok = ok && probe[i] == (uint8_t)(0xA5 ^ i);
	}
	printk("P4P1 smh probe: buf=%p %s\n", probe,
	       ok ? "读写一致（PSRAM 存活）" : "读写不一致");
	shared_multi_heap_free(probe);
	if (!ok || ((uintptr_t)probe >> 24) != 0x48U) {
		printk("P4P FAIL smh verify (addr domain)\n");
		return 1;
	}

	/* P4P2: 通道 + 链路（直启面；无 core_boot/linkmon 干扰） */
	if (ts_hal_register_dev(&ps_dev) != TS_OK ||
	    ts_safety_register_channel(&ps_ch) != TS_OK) {
		printk("P4P FAIL channel\n");
		return 1;
	}
	ts_safety_set_link(true);

	/* P4P3: APP 启动——WAMR 实例堆经 runtime 自 PSRAM 分配（console 有
	 * "[appmgr] wamr pool heap: buf=0x48... (psram/smh)" 行 = 位置证据） */
	if (ts_appmgr_app_start(1, app_wasm, app_wasm_len, "gpio:write:0-3") != TS_OK) {
		printk("P4P FAIL app_start\n");
		return 1;
	}
	if (!ps_wait_gpio(true)) {
		printk("P4P FAIL app_init write\n");
		return 1;
	}
	printk("P4P3 app_init -> gpio=1（WAMR 池=PSRAM，全链）\n");
	if (ts_appmgr_app_evt(0) == TS_OK && ps_wait_gpio(false)) {
		printk("P4P3 app_evt(0) -> gpio=0\n");
	} else {
		printk("P4P FAIL app_evt\n");
		return 1;
	}
	struct ts_app_rt_stats st;

	ts_appmgr_app_stats(&st);
	printk("P4P PASS init_res=%d evt_seen=%u heap=%uKB@PSRAM\n",
	       (int)st.init_res, st.evt_seen, CONFIG_TS_APP_WAMR_HEAP / 1024);
	for (;;) {
		k_msleep(5000);
		printk("P4P alive t=%u\n", (unsigned)k_uptime_get_32());
	}
}
```
