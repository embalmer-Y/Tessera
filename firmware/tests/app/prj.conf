## prj.conf
```kconfig
# SPDX-License-Identifier: Apache-2.0
CONFIG_ZTEST=y
CONFIG_TS_APP_WAMR=y
CONFIG_TS_TEST=y
CONFIG_TS_HAL_FS=y
CONFIG_TS_HAL_AV=y

# V0.4.0 M7（Q-32③）：双实例并行运行时回归
CONFIG_TS_APP_MAX_INSTANCES=2
CONFIG_TS_STORE_SLOT_COUNT=4
CONFIG_TS_APP_WAMR_HEAP=393216

# CG5-A：get-info caps 块测试面（net 命令分发桩——无 zenoh 传输）
CONFIG_TS_NET=y
CONFIG_TS_NET_ZENOH=n

# V0.8.0 EC2（Q-43③）：信任根表面（多根验签/trust-update 链）
CONFIG_TS_STORE_TRUST=y
CONFIG_TS_PERIPH=y

# F3（DEC-62①）：安装闸超时测试档（生产缺省 60000——用例 ⑦ 真等超时）
CONFIG_TS_APPMGR_PENDING_TIMEOUT_MS=400
```

## src/boot_pkg.h
```c
/* SPDX-License-Identifier: Apache-2.0 */
/* DEC-49④ 预签 boot 夹具（native_app.wasm + 测试根签名） */
#ifndef BOOT_PKG_H__
#define BOOT_PKG_H__

/* 机械生成（gen_fixture_pkg.py）——boot E2E 包（真 wasm），936B */
static const uint8_t boot_pkg[936] = {
	0x54, 0x53, 0x41, 0x50, 0x00, 0x02, 0x00, 0x00, 0x00, 0x78, 0x00, 0x00,
	0x01, 0x1e, 0x00, 0x01, 0xd0, 0xba, 0x69, 0xcb, 0xb2, 0x9f, 0x8a, 0x55,
	0x09, 0x24, 0x4d, 0x73, 0x2f, 0x40, 0xd2, 0xd9, 0x68, 0xdb, 0x3f, 0x9e,
	0x82, 0xd9, 0x04, 0x7f, 0xeb, 0x0a, 0xba, 0xd5, 0xb1, 0x7c, 0x6e, 0xb6,
	0xa7, 0x64, 0x63, 0x61, 0x70, 0x73, 0x81, 0x6e, 0x67, 0x70, 0x69, 0x6f,
	0x3a, 0x77, 0x72, 0x69, 0x74, 0x65, 0x3a, 0x30, 0x2d, 0x33, 0x66, 0x61,
	0x70, 0x70, 0x5f, 0x69, 0x64, 0x73, 0x63, 0x6f, 0x6d, 0x2e, 0x74, 0x65,
	0x73, 0x73, 0x65, 0x72, 0x61, 0x2e, 0x66, 0x69, 0x78, 0x74, 0x75, 0x72,
	0x65, 0x67, 0x61, 0x70, 0x70, 0x5f, 0x76, 0x65, 0x72, 0x65, 0x30, 0x2e,
	0x31, 0x2e, 0x30, 0x67, 0x65, 0x78, 0x70, 0x6f, 0x72, 0x74, 0x73, 0x81,
	0x6b, 0x68, 0x65, 0x61, 0x6c, 0x74, 0x68, 0x5f, 0x70, 0x69, 0x6e, 0x67,
	0x67, 0x68, 0x65, 0x61, 0x70, 0x5f, 0x6b, 0x62, 0x08, 0x68, 0x73, 0x74,
	0x61, 0x63, 0x6b, 0x5f, 0x6b, 0x62, 0x04, 0x6a, 0x6d, 0x69, 0x6e, 0x5f,
	0x66, 0x77, 0x5f, 0x76, 0x65, 0x72, 0x65, 0x30, 0x2e, 0x30, 0x2e, 0x31,
	0x00, 0x61, 0x73, 0x6d, 0x01, 0x00, 0x00, 0x00, 0x01, 0x11, 0x03, 0x60,
	0x03, 0x7f, 0x7f, 0x7f, 0x01, 0x7f, 0x60, 0x01, 0x7f, 0x01, 0x7f, 0x60,
	0x00, 0x01, 0x7f, 0x02, 0x15, 0x01, 0x03, 0x65, 0x6e, 0x76, 0x0d, 0x74,
	0x73, 0x5f, 0x67, 0x70, 0x69, 0x6f, 0x5f, 0x77, 0x72, 0x69, 0x74, 0x65,
	0x00, 0x00, 0x03, 0x06, 0x05, 0x01, 0x01, 0x02, 0x02, 0x02, 0x04, 0x05,
	0x01, 0x70, 0x01, 0x01, 0x01, 0x05, 0x03, 0x01, 0x00, 0x02, 0x06, 0x08,
	0x01, 0x7f, 0x01, 0x41, 0x90, 0x88, 0x04, 0x0b, 0x07, 0x47, 0x06, 0x06,
	0x6d, 0x65, 0x6d, 0x6f, 0x72, 0x79, 0x02, 0x00, 0x08, 0x61, 0x70, 0x70,
	0x5f, 0x69, 0x6e, 0x69, 0x74, 0x00, 0x01, 0x07, 0x61, 0x70, 0x70, 0x5f,
	0x65, 0x76, 0x74, 0x00, 0x02, 0x08, 0x61, 0x70, 0x70, 0x5f, 0x74, 0x69,
	0x63, 0x6b, 0x00, 0x03, 0x0b, 0x68, 0x65, 0x61, 0x6c, 0x74, 0x68, 0x5f,
	0x70, 0x69, 0x6e, 0x67, 0x00, 0x04, 0x0c, 0x67, 0x65, 0x74, 0x5f, 0x6c,
	0x61, 0x73, 0x74, 0x5f, 0x65, 0x76, 0x74, 0x00, 0x05, 0x0a, 0x76, 0x05,
	0x19, 0x00, 0x41, 0x00, 0x20, 0x00, 0x36, 0x02, 0x84, 0x88, 0x80, 0x80,
	0x00, 0x20, 0x00, 0x41, 0x00, 0x41, 0x01, 0x10, 0x80, 0x80, 0x80, 0x80,
	0x00, 0x0b, 0x3d, 0x00, 0x02, 0x40, 0x20, 0x00, 0x41, 0x80, 0x02, 0x71,
	0x45, 0x0d, 0x00, 0x41, 0x00, 0x41, 0x01, 0x36, 0x02, 0x88, 0x88, 0x80,
	0x80, 0x00, 0x41, 0x00, 0x0f, 0x0b, 0x41, 0x00, 0x20, 0x00, 0x36, 0x02,
	0x80, 0x88, 0x80, 0x80, 0x00, 0x41, 0x00, 0x28, 0x02, 0x84, 0x88, 0x80,
	0x80, 0x00, 0x41, 0x00, 0x20, 0x00, 0x41, 0x01, 0x71, 0x10, 0x80, 0x80,
	0x80, 0x80, 0x00, 0x0b, 0x04, 0x00, 0x41, 0x00, 0x0b, 0x0b, 0x00, 0x41,
	0x00, 0x28, 0x02, 0x88, 0x88, 0x80, 0x80, 0x00, 0x0b, 0x0b, 0x00, 0x41,
	0x00, 0x28, 0x02, 0x80, 0x88, 0x80, 0x80, 0x00, 0x0b, 0x0b, 0x0b, 0x01,
	0x00, 0x41, 0x80, 0x08, 0x0b, 0x04, 0xff, 0xff, 0xff, 0xff, 0xd2, 0x84,
	0x43, 0xa1, 0x01, 0x27, 0xa0, 0x59, 0x01, 0x96, 0xa7, 0x64, 0x63, 0x61,
	0x70, 0x73, 0x81, 0x6e, 0x67, 0x70, 0x69, 0x6f, 0x3a, 0x77, 0x72, 0x69,
	0x74, 0x65, 0x3a, 0x30, 0x2d, 0x33, 0x66, 0x61, 0x70, 0x70, 0x5f, 0x69,
	0x64, 0x73, 0x63, 0x6f, 0x6d, 0x2e, 0x74, 0x65, 0x73, 0x73, 0x65, 0x72,
	0x61, 0x2e, 0x66, 0x69, 0x78, 0x74, 0x75, 0x72, 0x65, 0x67, 0x61, 0x70,
	0x70, 0x5f, 0x76, 0x65, 0x72, 0x65, 0x30, 0x2e, 0x31, 0x2e, 0x30, 0x67,
	0x65, 0x78, 0x70, 0x6f, 0x72, 0x74, 0x73, 0x81, 0x6b, 0x68, 0x65, 0x61,
	0x6c, 0x74, 0x68, 0x5f, 0x70, 0x69, 0x6e, 0x67, 0x67, 0x68, 0x65, 0x61,
	0x70, 0x5f, 0x6b, 0x62, 0x08, 0x68, 0x73, 0x74, 0x61, 0x63, 0x6b, 0x5f,
	0x6b, 0x62, 0x04, 0x6a, 0x6d, 0x69, 0x6e, 0x5f, 0x66, 0x77, 0x5f, 0x76,
	0x65, 0x72, 0x65, 0x30, 0x2e, 0x30, 0x2e, 0x31, 0x00, 0x61, 0x73, 0x6d,
	0x01, 0x00, 0x00, 0x00, 0x01, 0x11, 0x03, 0x60, 0x03, 0x7f, 0x7f, 0x7f,
	0x01, 0x7f, 0x60, 0x01, 0x7f, 0x01, 0x7f, 0x60, 0x00, 0x01, 0x7f, 0x02,
	0x15, 0x01, 0x03, 0x65, 0x6e, 0x76, 0x0d, 0x74, 0x73, 0x5f, 0x67, 0x70,
	0x69, 0x6f, 0x5f, 0x77, 0x72, 0x69, 0x74, 0x65, 0x00, 0x00, 0x03, 0x06,
	0x05, 0x01, 0x01, 0x02, 0x02, 0x02, 0x04, 0x05, 0x01, 0x70, 0x01, 0x01,
	0x01, 0x05, 0x03, 0x01, 0x00, 0x02, 0x06, 0x08, 0x01, 0x7f, 0x01, 0x41,
	0x90, 0x88, 0x04, 0x0b, 0x07, 0x47, 0x06, 0x06, 0x6d, 0x65, 0x6d, 0x6f,
	0x72, 0x79, 0x02, 0x00, 0x08, 0x61, 0x70, 0x70, 0x5f, 0x69, 0x6e, 0x69,
	0x74, 0x00, 0x01, 0x07, 0x61, 0x70, 0x70, 0x5f, 0x65, 0x76, 0x74, 0x00,
	0x02, 0x08, 0x61, 0x70, 0x70, 0x5f, 0x74, 0x69, 0x63, 0x6b, 0x00, 0x03,
	0x0b, 0x68, 0x65, 0x61, 0x6c, 0x74, 0x68, 0x5f, 0x70, 0x69, 0x6e, 0x67,
	0x00, 0x04, 0x0c, 0x67, 0x65, 0x74, 0x5f, 0x6c, 0x61, 0x73, 0x74, 0x5f,
	0x65, 0x76, 0x74, 0x00, 0x05, 0x0a, 0x76, 0x05, 0x19, 0x00, 0x41, 0x00,
	0x20, 0x00, 0x36, 0x02, 0x84, 0x88, 0x80, 0x80, 0x00, 0x20, 0x00, 0x41,
	0x00, 0x41, 0x01, 0x10, 0x80, 0x80, 0x80, 0x80, 0x00, 0x0b, 0x3d, 0x00,
	0x02, 0x40, 0x20, 0x00, 0x41, 0x80, 0x02, 0x71, 0x45, 0x0d, 0x00, 0x41,
	0x00, 0x41, 0x01, 0x36, 0x02, 0x88, 0x88, 0x80, 0x80, 0x00, 0x41, 0x00,
	0x0f, 0x0b, 0x41, 0x00, 0x20, 0x00, 0x36, 0x02, 0x80, 0x88, 0x80, 0x80,
	0x00, 0x41, 0x00, 0x28, 0x02, 0x84, 0x88, 0x80, 0x80, 0x00, 0x41, 0x00,
	0x20, 0x00, 0x41, 0x01, 0x71, 0x10, 0x80, 0x80, 0x80, 0x80, 0x00, 0x0b,
	0x04, 0x00, 0x41, 0x00, 0x0b, 0x0b, 0x00, 0x41, 0x00, 0x28, 0x02, 0x88,
	0x88, 0x80, 0x80, 0x00, 0x0b, 0x0b, 0x00, 0x41, 0x00, 0x28, 0x02, 0x80,
	0x88, 0x80, 0x80, 0x00, 0x0b, 0x0b, 0x0b, 0x01, 0x00, 0x41, 0x80, 0x08,
	0x0b, 0x04, 0xff, 0xff, 0xff, 0xff, 0x58, 0x40, 0x0b, 0x02, 0x78, 0xcb,
	0x25, 0x5b, 0xca, 0xca, 0x75, 0x95, 0x81, 0xd3, 0x6e, 0x3e, 0xbe, 0x3d,
	0x23, 0x31, 0x8f, 0x99, 0x06, 0xd1, 0xe4, 0x71, 0x8a, 0x29, 0x71, 0xd4,
	0xcb, 0x0e, 0xd4, 0xf1, 0x94, 0x62, 0xf6, 0xf4, 0x23, 0x24, 0xb2, 0x4a,
	0x5f, 0x12, 0xbd, 0x63, 0x11, 0xe7, 0xfe, 0x1e, 0x1d, 0x0d, 0x85, 0xbd,
	0x90, 0xea, 0x13, 0xd5, 0xad, 0xf4, 0x0e, 0xa6, 0xc7, 0xec, 0x64, 0x01,
};

#endif /* BOOT_PKG_H__ */
```

## src/boot_pkg_devroot.h
```c
/* SPDX-License-Identifier: Apache-2.0 */
/* EC2 夹具：开发者键签名 TSAP 包（verify_slot NULL 多根实证） */
/* 机械生成（gen_trust_fixtures.py——重跑复现；禁手抄，教训 27） */
#ifndef BOOT_PKG_DEVROOT_H__
#define BOOT_PKG_DEVROOT_H__

static const uint8_t boot_pkg_devroot[996] = {
	0x54, 0x53, 0x41, 0x50, 0x00, 0x02, 0x00, 0x00, 0x00, 0x81, 0x00, 0x00,
	0x01, 0x33, 0x00, 0x01, 0xd6, 0x14, 0x3c, 0x71, 0xb3, 0x55, 0xd1, 0x9c,
	0xc3, 0x3a, 0x6f, 0xc7, 0x41, 0xfb, 0xa4, 0x00, 0x68, 0x73, 0xf7, 0x4f,
	0x21, 0xd6, 0x51, 0x36, 0x6d, 0x6d, 0x80, 0xdf, 0xcc, 0x24, 0xd1, 0x98,
	0xa7, 0x64, 0x63, 0x61, 0x70, 0x73, 0x81, 0x6e, 0x67, 0x70, 0x69, 0x6f,
	0x3a, 0x77, 0x72, 0x69, 0x74, 0x65, 0x3a, 0x30, 0x2d, 0x33, 0x66, 0x61,
	0x70, 0x70, 0x5f, 0x69, 0x64, 0x78, 0x1b, 0x63, 0x6f, 0x6d, 0x2e, 0x74,
	0x65, 0x73, 0x73, 0x65, 0x72, 0x61, 0x2e, 0x66, 0x69, 0x78, 0x74, 0x75,
	0x72, 0x65, 0x2e, 0x64, 0x65, 0x76, 0x72, 0x6f, 0x6f, 0x74, 0x67, 0x61,
	0x70, 0x70, 0x5f, 0x76, 0x65, 0x72, 0x65, 0x31, 0x2e, 0x30, 0x2e, 0x30,
	0x67, 0x65, 0x78, 0x70, 0x6f, 0x72, 0x74, 0x73, 0x81, 0x6b, 0x68, 0x65,
	0x61, 0x6c, 0x74, 0x68, 0x5f, 0x70, 0x69, 0x6e, 0x67, 0x67, 0x68, 0x65,
	0x61, 0x70, 0x5f, 0x6b, 0x62, 0x04, 0x68, 0x73, 0x74, 0x61, 0x63, 0x6b,
	0x5f, 0x6b, 0x62, 0x08, 0x6a, 0x6d, 0x69, 0x6e, 0x5f, 0x66, 0x77, 0x5f,
	0x76, 0x65, 0x72, 0x65, 0x30, 0x2e, 0x31, 0x2e, 0x30, 0x00, 0x61, 0x73,
	0x6d, 0x01, 0x00, 0x00, 0x00, 0x01, 0x11, 0x03, 0x60, 0x03, 0x7f, 0x7f,
	0x7f, 0x01, 0x7f, 0x60, 0x01, 0x7f, 0x01, 0x7f, 0x60, 0x00, 0x01, 0x7f,
	0x02, 0x15, 0x01, 0x03, 0x65, 0x6e, 0x76, 0x0d, 0x74, 0x73, 0x5f, 0x67,
	0x70, 0x69, 0x6f, 0x5f, 0x77, 0x72, 0x69, 0x74, 0x65, 0x00, 0x00, 0x03,
	0x06, 0x05, 0x01, 0x01, 0x02, 0x02, 0x02, 0x04, 0x05, 0x01, 0x70, 0x01,
	0x01, 0x01, 0x05, 0x03, 0x01, 0x00, 0x02, 0x06, 0x08, 0x01, 0x7f, 0x01,
	0x41, 0x90, 0x88, 0x04, 0x0b, 0x07, 0x47, 0x06, 0x06, 0x6d, 0x65, 0x6d,
	0x6f, 0x72, 0x79, 0x02, 0x00, 0x08, 0x61, 0x70, 0x70, 0x5f, 0x69, 0x6e,
	0x69, 0x74, 0x00, 0x01, 0x07, 0x61, 0x70, 0x70, 0x5f, 0x65, 0x76, 0x74,
	0x00, 0x02, 0x08, 0x61, 0x70, 0x70, 0x5f, 0x74, 0x69, 0x63, 0x6b, 0x00,
	0x03, 0x0b, 0x68, 0x65, 0x61, 0x6c, 0x74, 0x68, 0x5f, 0x70, 0x69, 0x6e,
	0x67, 0x00, 0x04, 0x0c, 0x67, 0x65, 0x74, 0x5f, 0x6c, 0x61, 0x73, 0x74,
	0x5f, 0x65, 0x76, 0x74, 0x00, 0x05, 0x0a, 0x86, 0x01, 0x05, 0x19, 0x00,
	0x41, 0x00, 0x20, 0x00, 0x36, 0x02, 0x88, 0x88, 0x80, 0x80, 0x00, 0x20,
	0x00, 0x41, 0x00, 0x41, 0x01, 0x10, 0x80, 0x80, 0x80, 0x80, 0x00, 0x0b,
	0x3d, 0x00, 0x02, 0x40, 0x20, 0x00, 0x41, 0x80, 0x02, 0x71, 0x45, 0x0d,
	0x00, 0x41, 0x00, 0x41, 0x01, 0x36, 0x02, 0x8c, 0x88, 0x80, 0x80, 0x00,
	0x41, 0x00, 0x0f, 0x0b, 0x41, 0x00, 0x20, 0x00, 0x36, 0x02, 0x80, 0x88,
	0x80, 0x80, 0x00, 0x41, 0x00, 0x28, 0x02, 0x88, 0x88, 0x80, 0x80, 0x00,
	0x41, 0x00, 0x20, 0x00, 0x41, 0x01, 0x71, 0x10, 0x80, 0x80, 0x80, 0x80,
	0x00, 0x0b, 0x04, 0x00, 0x41, 0x00, 0x0b, 0x1b, 0x01, 0x01, 0x7f, 0x41,
	0x00, 0x28, 0x02, 0x8c, 0x88, 0x80, 0x80, 0x00, 0x21, 0x00, 0x41, 0x00,
	0x28, 0x02, 0x84, 0x88, 0x80, 0x80, 0x00, 0x1a, 0x20, 0x00, 0x0b, 0x0b,
	0x00, 0x41, 0x00, 0x28, 0x02, 0x80, 0x88, 0x80, 0x80, 0x00, 0x0b, 0x0b,
	0x0f, 0x01, 0x00, 0x41, 0x80, 0x08, 0x0b, 0x08, 0xff, 0xff, 0xff, 0xff,
	0x09, 0x00, 0x00, 0x00, 0xd2, 0x84, 0x43, 0xa1, 0x01, 0x27, 0xa0, 0x59,
	0x01, 0xb4, 0xa7, 0x64, 0x63, 0x61, 0x70, 0x73, 0x81, 0x6e, 0x67, 0x70,
	0x69, 0x6f, 0x3a, 0x77, 0x72, 0x69, 0x74, 0x65, 0x3a, 0x30, 0x2d, 0x33,
	0x66, 0x61, 0x70, 0x70, 0x5f, 0x69, 0x64, 0x78, 0x1b, 0x63, 0x6f, 0x6d,
	0x2e, 0x74, 0x65, 0x73, 0x73, 0x65, 0x72, 0x61, 0x2e, 0x66, 0x69, 0x78,
	0x74, 0x75, 0x72, 0x65, 0x2e, 0x64, 0x65, 0x76, 0x72, 0x6f, 0x6f, 0x74,
	0x67, 0x61, 0x70, 0x70, 0x5f, 0x76, 0x65, 0x72, 0x65, 0x31, 0x2e, 0x30,
	0x2e, 0x30, 0x67, 0x65, 0x78, 0x70, 0x6f, 0x72, 0x74, 0x73, 0x81, 0x6b,
	0x68, 0x65, 0x61, 0x6c, 0x74, 0x68, 0x5f, 0x70, 0x69, 0x6e, 0x67, 0x67,
	0x68, 0x65, 0x61, 0x70, 0x5f, 0x6b, 0x62, 0x04, 0x68, 0x73, 0x74, 0x61,
	0x63, 0x6b, 0x5f, 0x6b, 0x62, 0x08, 0x6a, 0x6d, 0x69, 0x6e, 0x5f, 0x66,
	0x77, 0x5f, 0x76, 0x65, 0x72, 0x65, 0x30, 0x2e, 0x31, 0x2e, 0x30, 0x00,
	0x61, 0x73, 0x6d, 0x01, 0x00, 0x00, 0x00, 0x01, 0x11, 0x03, 0x60, 0x03,
	0x7f, 0x7f, 0x7f, 0x01, 0x7f, 0x60, 0x01, 0x7f, 0x01, 0x7f, 0x60, 0x00,
	0x01, 0x7f, 0x02, 0x15, 0x01, 0x03, 0x65, 0x6e, 0x76, 0x0d, 0x74, 0x73,
	0x5f, 0x67, 0x70, 0x69, 0x6f, 0x5f, 0x77, 0x72, 0x69, 0x74, 0x65, 0x00,
	0x00, 0x03, 0x06, 0x05, 0x01, 0x01, 0x02, 0x02, 0x02, 0x04, 0x05, 0x01,
	0x70, 0x01, 0x01, 0x01, 0x05, 0x03, 0x01, 0x00, 0x02, 0x06, 0x08, 0x01,
	0x7f, 0x01, 0x41, 0x90, 0x88, 0x04, 0x0b, 0x07, 0x47, 0x06, 0x06, 0x6d,
	0x65, 0x6d, 0x6f, 0x72, 0x79, 0x02, 0x00, 0x08, 0x61, 0x70, 0x70, 0x5f,
	0x69, 0x6e, 0x69, 0x74, 0x00, 0x01, 0x07, 0x61, 0x70, 0x70, 0x5f, 0x65,
	0x76, 0x74, 0x00, 0x02, 0x08, 0x61, 0x70, 0x70, 0x5f, 0x74, 0x69, 0x63,
	0x6b, 0x00, 0x03, 0x0b, 0x68, 0x65, 0x61, 0x6c, 0x74, 0x68, 0x5f, 0x70,
	0x69, 0x6e, 0x67, 0x00, 0x04, 0x0c, 0x67, 0x65, 0x74, 0x5f, 0x6c, 0x61,
	0x73, 0x74, 0x5f, 0x65, 0x76, 0x74, 0x00, 0x05, 0x0a, 0x86, 0x01, 0x05,
	0x19, 0x00, 0x41, 0x00, 0x20, 0x00, 0x36, 0x02, 0x88, 0x88, 0x80, 0x80,
	0x00, 0x20, 0x00, 0x41, 0x00, 0x41, 0x01, 0x10, 0x80, 0x80, 0x80, 0x80,
	0x00, 0x0b, 0x3d, 0x00, 0x02, 0x40, 0x20, 0x00, 0x41, 0x80, 0x02, 0x71,
	0x45, 0x0d, 0x00, 0x41, 0x00, 0x41, 0x01, 0x36, 0x02, 0x8c, 0x88, 0x80,
	0x80, 0x00, 0x41, 0x00, 0x0f, 0x0b, 0x41, 0x00, 0x20, 0x00, 0x36, 0x02,
	0x80, 0x88, 0x80, 0x80, 0x00, 0x41, 0x00, 0x28, 0x02, 0x88, 0x88, 0x80,
	0x80, 0x00, 0x41, 0x00, 0x20, 0x00, 0x41, 0x01, 0x71, 0x10, 0x80, 0x80,
	0x80, 0x80, 0x00, 0x0b, 0x04, 0x00, 0x41, 0x00, 0x0b, 0x1b, 0x01, 0x01,
	0x7f, 0x41, 0x00, 0x28, 0x02, 0x8c, 0x88, 0x80, 0x80, 0x00, 0x21, 0x00,
	0x41, 0x00, 0x28, 0x02, 0x84, 0x88, 0x80, 0x80, 0x00, 0x1a, 0x20, 0x00,
	0x0b, 0x0b, 0x00, 0x41, 0x00, 0x28, 0x02, 0x80, 0x88, 0x80, 0x80, 0x00,
	0x0b, 0x0b, 0x0f, 0x01, 0x00, 0x41, 0x80, 0x08, 0x0b, 0x08, 0xff, 0xff,
	0xff, 0xff, 0x09, 0x00, 0x00, 0x00, 0x58, 0x40, 0x5d, 0xfb, 0xdd, 0x6e,
	0xbc, 0x77, 0x74, 0x23, 0xb7, 0x05, 0xa3, 0x98, 0x1c, 0xe2, 0xd0, 0x3e,
	0xb2, 0x4d, 0xd1, 0x07, 0x9d, 0x69, 0xdc, 0x36, 0x8e, 0x6a, 0x78, 0xe8,
	0x68, 0xad, 0x00, 0xe8, 0xf2, 0x56, 0x4b, 0x38, 0x51, 0xaa, 0x75, 0xed,
	0x86, 0x4c, 0x3b, 0x8b, 0x51, 0x15, 0x74, 0xbd, 0xe2, 0xd6, 0x51, 0x1b,
	0xab, 0xa4, 0x88, 0xf7, 0xb4, 0xc7, 0x73, 0x90, 0x5e, 0x62, 0xdb, 0x01,
};

#endif
```

## src/boot_pkg_large.h
```c
/* SPDX-License-Identifier: Apache-2.0 */
/* CG4 档位夹具：tier=large + needs + 差异化 wasm（native_sim small-only → 安装期匹配拒装；boot 直装走查用） */
/* 机械生成（gen_tier_pkgs.py——重跑复现；禁手抄，教训 27） */
#ifndef BOOT_PKG_LARGE_H__
#define BOOT_PKG_LARGE_H__

static const uint8_t boot_pkg_large[1124] = {
	0x54, 0x53, 0x41, 0x50, 0x00, 0x02, 0x00, 0x00, 0x00, 0xc1, 0x00, 0x00,
	0x01, 0x33, 0x00, 0x01, 0x5c, 0x94, 0x84, 0x8c, 0xf2, 0x2d, 0x66, 0x24,
	0xff, 0xcc, 0xc4, 0x09, 0x35, 0x5a, 0xf7, 0xf7, 0x06, 0x01, 0xd3, 0xc3,
	0x22, 0x4d, 0x7d, 0xed, 0x9d, 0x0a, 0xa5, 0x6d, 0x30, 0xec, 0xad, 0xef,
	0xa9, 0x64, 0x63, 0x61, 0x70, 0x73, 0x81, 0x6e, 0x67, 0x70, 0x69, 0x6f,
	0x3a, 0x77, 0x72, 0x69, 0x74, 0x65, 0x3a, 0x30, 0x2d, 0x33, 0x64, 0x74,
	0x69, 0x65, 0x72, 0x65, 0x6c, 0x61, 0x72, 0x67, 0x65, 0x65, 0x6e, 0x65,
	0x65, 0x64, 0x73, 0xa3, 0x68, 0x73, 0x74, 0x61, 0x63, 0x6b, 0x5f, 0x6b,
	0x62, 0x10, 0x69, 0x72, 0x65, 0x73, 0x6f, 0x75, 0x72, 0x63, 0x65, 0x73,
	0x81, 0x68, 0x2f, 0x53, 0x44, 0x3a, 0x2f, 0x72, 0x65, 0x73, 0x70, 0x6c,
	0x69, 0x6e, 0x65, 0x61, 0x72, 0x5f, 0x6d, 0x65, 0x6d, 0x6f, 0x72, 0x79,
	0x5f, 0x6b, 0x62, 0x18, 0x40, 0x66, 0x61, 0x70, 0x70, 0x5f, 0x69, 0x64,
	0x78, 0x18, 0x63, 0x6f, 0x6d, 0x2e, 0x74, 0x65, 0x73, 0x73, 0x65, 0x72,
	0x61, 0x2e, 0x66, 0x69, 0x78, 0x74, 0x75, 0x72, 0x65, 0x2e, 0x74, 0x69,
	0x65, 0x72, 0x67, 0x61, 0x70, 0x70, 0x5f, 0x76, 0x65, 0x72, 0x65, 0x31,
	0x2e, 0x30, 0x2e, 0x30, 0x67, 0x65, 0x78, 0x70, 0x6f, 0x72, 0x74, 0x73,
	0x81, 0x6b, 0x68, 0x65, 0x61, 0x6c, 0x74, 0x68, 0x5f, 0x70, 0x69, 0x6e,
	0x67, 0x67, 0x68, 0x65, 0x61, 0x70, 0x5f, 0x6b, 0x62, 0x04, 0x68, 0x73,
	0x74, 0x61, 0x63, 0x6b, 0x5f, 0x6b, 0x62, 0x08, 0x6a, 0x6d, 0x69, 0x6e,
	0x5f, 0x66, 0x77, 0x5f, 0x76, 0x65, 0x72, 0x65, 0x30, 0x2e, 0x31, 0x2e,
	0x30, 0x00, 0x61, 0x73, 0x6d, 0x01, 0x00, 0x00, 0x00, 0x01, 0x11, 0x03,
	0x60, 0x03, 0x7f, 0x7f, 0x7f, 0x01, 0x7f, 0x60, 0x01, 0x7f, 0x01, 0x7f,
	0x60, 0x00, 0x01, 0x7f, 0x02, 0x15, 0x01, 0x03, 0x65, 0x6e, 0x76, 0x0d,
	0x74, 0x73, 0x5f, 0x67, 0x70, 0x69, 0x6f, 0x5f, 0x77, 0x72, 0x69, 0x74,
	0x65, 0x00, 0x00, 0x03, 0x06, 0x05, 0x01, 0x01, 0x02, 0x02, 0x02, 0x04,
	0x05, 0x01, 0x70, 0x01, 0x01, 0x01, 0x05, 0x03, 0x01, 0x00, 0x02, 0x06,
	0x08, 0x01, 0x7f, 0x01, 0x41, 0x90, 0x88, 0x04, 0x0b, 0x07, 0x47, 0x06,
	0x06, 0x6d, 0x65, 0x6d, 0x6f, 0x72, 0x79, 0x02, 0x00, 0x08, 0x61, 0x70,
	0x70, 0x5f, 0x69, 0x6e, 0x69, 0x74, 0x00, 0x01, 0x07, 0x61, 0x70, 0x70,
	0x5f, 0x65, 0x76, 0x74, 0x00, 0x02, 0x08, 0x61, 0x70, 0x70, 0x5f, 0x74,
	0x69, 0x63, 0x6b, 0x00, 0x03, 0x0b, 0x68, 0x65, 0x61, 0x6c, 0x74, 0x68,
	0x5f, 0x70, 0x69, 0x6e, 0x67, 0x00, 0x04, 0x0c, 0x67, 0x65, 0x74, 0x5f,
	0x6c, 0x61, 0x73, 0x74, 0x5f, 0x65, 0x76, 0x74, 0x00, 0x05, 0x0a, 0x86,
	0x01, 0x05, 0x19, 0x00, 0x41, 0x00, 0x20, 0x00, 0x36, 0x02, 0x88, 0x88,
	0x80, 0x80, 0x00, 0x20, 0x00, 0x41, 0x00, 0x41, 0x01, 0x10, 0x80, 0x80,
	0x80, 0x80, 0x00, 0x0b, 0x3d, 0x00, 0x02, 0x40, 0x20, 0x00, 0x41, 0x80,
	0x02, 0x71, 0x45, 0x0d, 0x00, 0x41, 0x00, 0x41, 0x01, 0x36, 0x02, 0x8c,
	0x88, 0x80, 0x80, 0x00, 0x41, 0x00, 0x0f, 0x0b, 0x41, 0x00, 0x20, 0x00,
	0x36, 0x02, 0x80, 0x88, 0x80, 0x80, 0x00, 0x41, 0x00, 0x28, 0x02, 0x88,
	0x88, 0x80, 0x80, 0x00, 0x41, 0x00, 0x20, 0x00, 0x41, 0x01, 0x71, 0x10,
	0x80, 0x80, 0x80, 0x80, 0x00, 0x0b, 0x04, 0x00, 0x41, 0x00, 0x0b, 0x1b,
	0x01, 0x01, 0x7f, 0x41, 0x00, 0x28, 0x02, 0x8c, 0x88, 0x80, 0x80, 0x00,
	0x21, 0x00, 0x41, 0x00, 0x28, 0x02, 0x84, 0x88, 0x80, 0x80, 0x00, 0x1a,
	0x20, 0x00, 0x0b, 0x0b, 0x00, 0x41, 0x00, 0x28, 0x02, 0x80, 0x88, 0x80,
	0x80, 0x00, 0x0b, 0x0b, 0x0f, 0x01, 0x00, 0x41, 0x80, 0x08, 0x0b, 0x08,
	0xff, 0xff, 0xff, 0xff, 0x07, 0x00, 0x00, 0x00, 0xd2, 0x84, 0x43, 0xa1,
	0x01, 0x27, 0xa0, 0x59, 0x01, 0xf4, 0xa9, 0x64, 0x63, 0x61, 0x70, 0x73,
	0x81, 0x6e, 0x67, 0x70, 0x69, 0x6f, 0x3a, 0x77, 0x72, 0x69, 0x74, 0x65,
	0x3a, 0x30, 0x2d, 0x33, 0x64, 0x74, 0x69, 0x65, 0x72, 0x65, 0x6c, 0x61,
	0x72, 0x67, 0x65, 0x65, 0x6e, 0x65, 0x65, 0x64, 0x73, 0xa3, 0x68, 0x73,
	0x74, 0x61, 0x63, 0x6b, 0x5f, 0x6b, 0x62, 0x10, 0x69, 0x72, 0x65, 0x73,
	0x6f, 0x75, 0x72, 0x63, 0x65, 0x73, 0x81, 0x68, 0x2f, 0x53, 0x44, 0x3a,
	0x2f, 0x72, 0x65, 0x73, 0x70, 0x6c, 0x69, 0x6e, 0x65, 0x61, 0x72, 0x5f,
	0x6d, 0x65, 0x6d, 0x6f, 0x72, 0x79, 0x5f, 0x6b, 0x62, 0x18, 0x40, 0x66,
	0x61, 0x70, 0x70, 0x5f, 0x69, 0x64, 0x78, 0x18, 0x63, 0x6f, 0x6d, 0x2e,
	0x74, 0x65, 0x73, 0x73, 0x65, 0x72, 0x61, 0x2e, 0x66, 0x69, 0x78, 0x74,
	0x75, 0x72, 0x65, 0x2e, 0x74, 0x69, 0x65, 0x72, 0x67, 0x61, 0x70, 0x70,
	0x5f, 0x76, 0x65, 0x72, 0x65, 0x31, 0x2e, 0x30, 0x2e, 0x30, 0x67, 0x65,
	0x78, 0x70, 0x6f, 0x72, 0x74, 0x73, 0x81, 0x6b, 0x68, 0x65, 0x61, 0x6c,
	0x74, 0x68, 0x5f, 0x70, 0x69, 0x6e, 0x67, 0x67, 0x68, 0x65, 0x61, 0x70,
	0x5f, 0x6b, 0x62, 0x04, 0x68, 0x73, 0x74, 0x61, 0x63, 0x6b, 0x5f, 0x6b,
	0x62, 0x08, 0x6a, 0x6d, 0x69, 0x6e, 0x5f, 0x66, 0x77, 0x5f, 0x76, 0x65,
	0x72, 0x65, 0x30, 0x2e, 0x31, 0x2e, 0x30, 0x00, 0x61, 0x73, 0x6d, 0x01,
	0x00, 0x00, 0x00, 0x01, 0x11, 0x03, 0x60, 0x03, 0x7f, 0x7f, 0x7f, 0x01,
	0x7f, 0x60, 0x01, 0x7f, 0x01, 0x7f, 0x60, 0x00, 0x01, 0x7f, 0x02, 0x15,
	0x01, 0x03, 0x65, 0x6e, 0x76, 0x0d, 0x74, 0x73, 0x5f, 0x67, 0x70, 0x69,
	0x6f, 0x5f, 0x77, 0x72, 0x69, 0x74, 0x65, 0x00, 0x00, 0x03, 0x06, 0x05,
	0x01, 0x01, 0x02, 0x02, 0x02, 0x04, 0x05, 0x01, 0x70, 0x01, 0x01, 0x01,
	0x05, 0x03, 0x01, 0x00, 0x02, 0x06, 0x08, 0x01, 0x7f, 0x01, 0x41, 0x90,
	0x88, 0x04, 0x0b, 0x07, 0x47, 0x06, 0x06, 0x6d, 0x65, 0x6d, 0x6f, 0x72,
	0x79, 0x02, 0x00, 0x08, 0x61, 0x70, 0x70, 0x5f, 0x69, 0x6e, 0x69, 0x74,
	0x00, 0x01, 0x07, 0x61, 0x70, 0x70, 0x5f, 0x65, 0x76, 0x74, 0x00, 0x02,
	0x08, 0x61, 0x70, 0x70, 0x5f, 0x74, 0x69, 0x63, 0x6b, 0x00, 0x03, 0x0b,
	0x68, 0x65, 0x61, 0x6c, 0x74, 0x68, 0x5f, 0x70, 0x69, 0x6e, 0x67, 0x00,
	0x04, 0x0c, 0x67, 0x65, 0x74, 0x5f, 0x6c, 0x61, 0x73, 0x74, 0x5f, 0x65,
	0x76, 0x74, 0x00, 0x05, 0x0a, 0x86, 0x01, 0x05, 0x19, 0x00, 0x41, 0x00,
	0x20, 0x00, 0x36, 0x02, 0x88, 0x88, 0x80, 0x80, 0x00, 0x20, 0x00, 0x41,
	0x00, 0x41, 0x01, 0x10, 0x80, 0x80, 0x80, 0x80, 0x00, 0x0b, 0x3d, 0x00,
	0x02, 0x40, 0x20, 0x00, 0x41, 0x80, 0x02, 0x71, 0x45, 0x0d, 0x00, 0x41,
	0x00, 0x41, 0x01, 0x36, 0x02, 0x8c, 0x88, 0x80, 0x80, 0x00, 0x41, 0x00,
	0x0f, 0x0b, 0x41, 0x00, 0x20, 0x00, 0x36, 0x02, 0x80, 0x88, 0x80, 0x80,
	0x00, 0x41, 0x00, 0x28, 0x02, 0x88, 0x88, 0x80, 0x80, 0x00, 0x41, 0x00,
	0x20, 0x00, 0x41, 0x01, 0x71, 0x10, 0x80, 0x80, 0x80, 0x80, 0x00, 0x0b,
	0x04, 0x00, 0x41, 0x00, 0x0b, 0x1b, 0x01, 0x01, 0x7f, 0x41, 0x00, 0x28,
	0x02, 0x8c, 0x88, 0x80, 0x80, 0x00, 0x21, 0x00, 0x41, 0x00, 0x28, 0x02,
	0x84, 0x88, 0x80, 0x80, 0x00, 0x1a, 0x20, 0x00, 0x0b, 0x0b, 0x00, 0x41,
	0x00, 0x28, 0x02, 0x80, 0x88, 0x80, 0x80, 0x00, 0x0b, 0x0b, 0x0f, 0x01,
	0x00, 0x41, 0x80, 0x08, 0x0b, 0x08, 0xff, 0xff, 0xff, 0xff, 0x07, 0x00,
	0x00, 0x00, 0x58, 0x40, 0x99, 0x39, 0x93, 0xfe, 0xb2, 0x1a, 0x27, 0x4d,
	0x3b, 0x67, 0xed, 0x60, 0xc2, 0x84, 0x51, 0x73, 0xc2, 0x95, 0xce, 0xbe,
	0x61, 0xc1, 0x73, 0xcf, 0xbc, 0x3c, 0x0f, 0xe5, 0x73, 0xd5, 0xbb, 0x92,
	0x59, 0x22, 0xfa, 0x9c, 0x22, 0x15, 0xce, 0xeb, 0xd8, 0xc9, 0xa0, 0x39,
	0x5c, 0x1b, 0xe1, 0x83, 0xea, 0x88, 0x7a, 0xe9, 0x65, 0x2e, 0x6e, 0xa6,
	0x3a, 0x17, 0x7a, 0x55, 0x58, 0x31, 0xd3, 0x0a,
};

#endif
```

## src/trust_blob_add.h
```c
/* SPDX-License-Identifier: Apache-2.0 */
/* EC2 夹具：ver=1 keys=[dev] 签名=测试根（首次注册） */
/* 机械生成（gen_trust_fixtures.py——重跑复现；禁手抄，教训 27） */
#ifndef TRUST_BLOB_ADD_H__
#define TRUST_BLOB_ADD_H__

static const uint8_t trust_blob_add[121] = {
	0xd2, 0x84, 0x43, 0xa1, 0x01, 0x27, 0xa0, 0x58, 0x2e, 0xa2, 0x63, 0x76,
	0x65, 0x72, 0x01, 0x64, 0x6b, 0x65, 0x79, 0x73, 0x81, 0x58, 0x20, 0x79,
	0xb5, 0x56, 0x2e, 0x8f, 0xe6, 0x54, 0xf9, 0x40, 0x78, 0xb1, 0x12, 0xe8,
	0xa9, 0x8b, 0xa7, 0x90, 0x1f, 0x85, 0x3a, 0xe6, 0x95, 0xbe, 0xd7, 0xe0,
	0xe3, 0x91, 0x0b, 0xad, 0x04, 0x96, 0x64, 0x58, 0x40, 0xed, 0x95, 0x4a,
	0xdd, 0x72, 0x5f, 0x5c, 0xdb, 0x19, 0x45, 0x04, 0x60, 0x3b, 0x62, 0xc6,
	0x38, 0x8c, 0xd0, 0x56, 0x65, 0x72, 0xc8, 0x6f, 0x9c, 0x29, 0x5f, 0x92,
	0x82, 0x16, 0xaa, 0xd2, 0x20, 0x10, 0x46, 0x9f, 0x62, 0x93, 0x99, 0xc1,
	0xf7, 0x5c, 0x4e, 0x7a, 0x75, 0xaf, 0x36, 0xcc, 0xa7, 0xd3, 0xfe, 0xce,
	0x58, 0xe7, 0xbd, 0xa5, 0xb7, 0xe4, 0xbc, 0x9b, 0x83, 0x85, 0x4f, 0xdb,
	0x0e,
};

#endif
```

## src/trust_blob_clear.h
```c
/* SPDX-License-Identifier: Apache-2.0 */
/* EC2 夹具：ver=3 keys=[] 签名=测试根（全撤回工厂根单源） */
/* 机械生成（gen_trust_fixtures.py——重跑复现；禁手抄，教训 27） */
#ifndef TRUST_BLOB_CLEAR_H__
#define TRUST_BLOB_CLEAR_H__

static const uint8_t trust_blob_clear[86] = {
	0xd2, 0x84, 0x43, 0xa1, 0x01, 0x27, 0xa0, 0x4c, 0xa2, 0x63, 0x76, 0x65,
	0x72, 0x03, 0x64, 0x6b, 0x65, 0x79, 0x73, 0x80, 0x58, 0x40, 0x2f, 0xc7,
	0x39, 0x75, 0x4a, 0xe7, 0x45, 0x95, 0xa1, 0xd1, 0x5d, 0x1e, 0x52, 0x49,
	0x09, 0xbc, 0x13, 0x51, 0x01, 0xa2, 0x11, 0x8f, 0x77, 0x8e, 0x39, 0x73,
	0x8b, 0xab, 0x55, 0xb0, 0x26, 0x02, 0x1b, 0x71, 0x9c, 0xfa, 0x9d, 0x46,
	0x17, 0x69, 0xfe, 0x37, 0xc0, 0xd2, 0x62, 0x44, 0xf7, 0xce, 0xde, 0xa5,
	0x76, 0xbf, 0x98, 0x7c, 0x0a, 0xc4, 0x24, 0xab, 0xa4, 0x19, 0xea, 0xa2,
	0x35, 0x00,
};

#endif
```

## src/trust_blob_dev_signed.h
```c
/* SPDX-License-Identifier: Apache-2.0 */
/* EC2 夹具：ver=2 keys=[dev] 签名=开发者键（有效集内互荐） */
/* 机械生成（gen_trust_fixtures.py——重跑复现；禁手抄，教训 27） */
#ifndef TRUST_BLOB_DEV_SIGNED_H__
#define TRUST_BLOB_DEV_SIGNED_H__

static const uint8_t trust_blob_dev_signed[121] = {
	0xd2, 0x84, 0x43, 0xa1, 0x01, 0x27, 0xa0, 0x58, 0x2e, 0xa2, 0x63, 0x76,
	0x65, 0x72, 0x02, 0x64, 0x6b, 0x65, 0x79, 0x73, 0x81, 0x58, 0x20, 0x79,
	0xb5, 0x56, 0x2e, 0x8f, 0xe6, 0x54, 0xf9, 0x40, 0x78, 0xb1, 0x12, 0xe8,
	0xa9, 0x8b, 0xa7, 0x90, 0x1f, 0x85, 0x3a, 0xe6, 0x95, 0xbe, 0xd7, 0xe0,
	0xe3, 0x91, 0x0b, 0xad, 0x04, 0x96, 0x64, 0x58, 0x40, 0xc3, 0x52, 0xe0,
	0x68, 0x11, 0x86, 0xc0, 0xed, 0x0e, 0x87, 0x6c, 0x55, 0x5e, 0xbc, 0xd7,
	0xc0, 0xf3, 0x81, 0x79, 0xf9, 0xb2, 0x91, 0xde, 0xfc, 0x8c, 0x2b, 0x9b,
	0x9c, 0x2d, 0xe8, 0x7c, 0xe1, 0xbf, 0x5c, 0x52, 0x50, 0xed, 0x95, 0x9b,
	0x2d, 0x6b, 0x01, 0xb6, 0x6a, 0x2d, 0x4d, 0x53, 0xe4, 0xda, 0x46, 0xff,
	0x8b, 0x04, 0x58, 0x9e, 0xa9, 0xd5, 0xee, 0x99, 0xe8, 0xa7, 0x78, 0xf3,
	0x0c,
};

#endif
```

## src/trust_blob_replay.h
```c
/* SPDX-License-Identifier: Apache-2.0 */
/* EC2 夹具：ver=1 重放样例（已应用 → E_RANGE） */
/* 机械生成（gen_trust_fixtures.py——重跑复现；禁手抄，教训 27） */
#ifndef TRUST_BLOB_REPLAY_H__
#define TRUST_BLOB_REPLAY_H__

static const uint8_t trust_blob_replay[121] = {
	0xd2, 0x84, 0x43, 0xa1, 0x01, 0x27, 0xa0, 0x58, 0x2e, 0xa2, 0x63, 0x76,
	0x65, 0x72, 0x01, 0x64, 0x6b, 0x65, 0x79, 0x73, 0x81, 0x58, 0x20, 0x79,
	0xb5, 0x56, 0x2e, 0x8f, 0xe6, 0x54, 0xf9, 0x40, 0x78, 0xb1, 0x12, 0xe8,
	0xa9, 0x8b, 0xa7, 0x90, 0x1f, 0x85, 0x3a, 0xe6, 0x95, 0xbe, 0xd7, 0xe0,
	0xe3, 0x91, 0x0b, 0xad, 0x04, 0x96, 0x64, 0x58, 0x40, 0xed, 0x95, 0x4a,
	0xdd, 0x72, 0x5f, 0x5c, 0xdb, 0x19, 0x45, 0x04, 0x60, 0x3b, 0x62, 0xc6,
	0x38, 0x8c, 0xd0, 0x56, 0x65, 0x72, 0xc8, 0x6f, 0x9c, 0x29, 0x5f, 0x92,
	0x82, 0x16, 0xaa, 0xd2, 0x20, 0x10, 0x46, 0x9f, 0x62, 0x93, 0x99, 0xc1,
	0xf7, 0x5c, 0x4e, 0x7a, 0x75, 0xaf, 0x36, 0xcc, 0xa7, 0xd3, 0xfe, 0xce,
	0x58, 0xe7, 0xbd, 0xa5, 0xb7, 0xe4, 0xbc, 0x9b, 0x83, 0x85, 0x4f, 0xdb,
	0x0e,
};

#endif
```

## src/trust_blob_skip.h
```c
/* SPDX-License-Identifier: Apache-2.0 */
/* EC2 夹具：ver=9 跳版样例（→ E_RANGE） */
/* 机械生成（gen_trust_fixtures.py——重跑复现；禁手抄，教训 27） */
#ifndef TRUST_BLOB_SKIP_H__
#define TRUST_BLOB_SKIP_H__

static const uint8_t trust_blob_skip[121] = {
	0xd2, 0x84, 0x43, 0xa1, 0x01, 0x27, 0xa0, 0x58, 0x2e, 0xa2, 0x63, 0x76,
	0x65, 0x72, 0x09, 0x64, 0x6b, 0x65, 0x79, 0x73, 0x81, 0x58, 0x20, 0x79,
	0xb5, 0x56, 0x2e, 0x8f, 0xe6, 0x54, 0xf9, 0x40, 0x78, 0xb1, 0x12, 0xe8,
	0xa9, 0x8b, 0xa7, 0x90, 0x1f, 0x85, 0x3a, 0xe6, 0x95, 0xbe, 0xd7, 0xe0,
	0xe3, 0x91, 0x0b, 0xad, 0x04, 0x96, 0x64, 0x58, 0x40, 0x11, 0x4f, 0xfe,
	0x24, 0x5e, 0xdc, 0x96, 0x22, 0x50, 0x88, 0x5a, 0xa8, 0x1e, 0x85, 0x5b,
	0x82, 0x5c, 0x89, 0xef, 0x0f, 0xc4, 0xeb, 0xf4, 0x19, 0xce, 0x29, 0x0e,
	0x12, 0xc0, 0xf5, 0xa6, 0x5c, 0x5d, 0x81, 0xf6, 0xa4, 0x05, 0xd9, 0x51,
	0x1d, 0x7f, 0x44, 0xd2, 0x90, 0x4e, 0x62, 0x06, 0x66, 0x2f, 0x84, 0x9d,
	0x79, 0x7d, 0x90, 0x54, 0x51, 0x3b, 0x6c, 0x14, 0xdc, 0xa4, 0x49, 0xa1,
	0x06,
};

#endif
```

## src/trust_blob_unauth.h
```c
/* SPDX-License-Identifier: Apache-2.0 */
/* EC2 夹具：ver=1 签名=陌生键（ver 门过/签名拒 → E_INVALID_SIG；置于 add 之前消费） */
/* 机械生成（gen_trust_fixtures.py——重跑复现；禁手抄，教训 27） */
#ifndef TRUST_BLOB_UNAUTH_H__
#define TRUST_BLOB_UNAUTH_H__

static const uint8_t trust_blob_unauth[121] = {
	0xd2, 0x84, 0x43, 0xa1, 0x01, 0x27, 0xa0, 0x58, 0x2e, 0xa2, 0x63, 0x76,
	0x65, 0x72, 0x01, 0x64, 0x6b, 0x65, 0x79, 0x73, 0x81, 0x58, 0x20, 0x79,
	0xb5, 0x56, 0x2e, 0x8f, 0xe6, 0x54, 0xf9, 0x40, 0x78, 0xb1, 0x12, 0xe8,
	0xa9, 0x8b, 0xa7, 0x90, 0x1f, 0x85, 0x3a, 0xe6, 0x95, 0xbe, 0xd7, 0xe0,
	0xe3, 0x91, 0x0b, 0xad, 0x04, 0x96, 0x64, 0x58, 0x40, 0x38, 0xc1, 0x63,
	0x36, 0x29, 0x13, 0xda, 0xfc, 0x06, 0x5d, 0x77, 0x8d, 0xdc, 0x05, 0x5c,
	0x1a, 0xf1, 0x6c, 0x39, 0x84, 0x83, 0x19, 0xee, 0x53, 0x1e, 0x48, 0xab,
	0xa9, 0x3a, 0x50, 0xab, 0x36, 0x13, 0x80, 0xb3, 0x53, 0x69, 0x7d, 0x76,
	0x1b, 0x0b, 0xc1, 0xc9, 0xfc, 0x8f, 0xa4, 0x47, 0x8f, 0xbf, 0x95, 0x20,
	0xac, 0x69, 0x36, 0x00, 0xdb, 0xe8, 0xfd, 0x02, 0xa0, 0x61, 0x58, 0xaf,
	0x0a,
};

#endif
```

## src/trust_dev_pub.h
```c
/* SPDX-License-Identifier: Apache-2.0 */
/* EC2 夹具：开发者公钥（固定种子派生） */
/* 机械生成（gen_trust_fixtures.py——重跑复现；禁手抄，教训 27） */
#ifndef TRUST_DEV_PUB_H__
#define TRUST_DEV_PUB_H__

static const uint8_t trust_dev_pub[32] = {
	0x79, 0xb5, 0x56, 0x2e, 0x8f, 0xe6, 0x54, 0xf9, 0x40, 0x78, 0xb1, 0x12,
	0xe8, 0xa9, 0x8b, 0xa7, 0x90, 0x1f, 0x85, 0x3a, 0xe6, 0x95, 0xbe, 0xd7,
	0xe0, 0xe3, 0x91, 0x0b, 0xad, 0x04, 0x96, 0x64,
};

#endif
```
