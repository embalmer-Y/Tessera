## CMakeLists.txt
```
# SPDX-License-Identifier: Apache-2.0
cmake_minimum_required(VERSION 3.20.0)
find_package(Zephyr REQUIRED HINTS $ENV{ZEPHYR_BASE})
project(tessera_psrambench)

target_sources(app PRIVATE src/main.c)
```

## prj.conf
```kconfig
# SPDX-License-Identifier: Apache-2.0
# psrambench（板级六）：PSRAM 挂接验证——SMH 探针（读写一致性 + 外部 RAM
# 地址域）+ WAMR 实例堆入 PSRAM（DEC-27 #10 池模式，HLD §4.6 分层纪律）
# + APP 全链运行。直启面（framework.app 同款，无 core_boot）。
CONFIG_PRINTK=y
CONFIG_TS_CORE=y
CONFIG_TS_SAFETY=y
CONFIG_TS_APP_WAMR=y
# 本基准无网面/无持久化（板级四/五已测）
CONFIG_TS_NET=n
CONFIG_MAIN_THREAD_PRIORITY=15
```

## boards/xiao_esp32s3_esp32s3_procpu.conf
```kconfig
# DEC-27 / HLD §4.6 esp32s3 每板默认：WAMR 实例堆 256KB 入 PSRAM。
# xiao_esp32s3 = N8R8 模组（8MB 八线 PSRAM）→ SPIRAM_MODE_OCT 必须显式
# （默认 QUAD 探测失败 = esp_init_psram 硬停）。
CONFIG_ESP_SPIRAM=y
CONFIG_SPIRAM_MODE_OCT=y
CONFIG_ESP_SPIRAM_MEMTEST=y
CONFIG_TS_APP_PSRAM_HEAP=y
CONFIG_TS_APP_WAMR_HEAP=262144
# 板级内存片段（DEC-23/27 过渡值；RAM slot 后端数组按此尺寸编入）
CONFIG_TS_STORE_SLOT_SIZE=32768
CONFIG_TS_APP_THREAD_STACK=16384
# 4.5 复验批（同型防御）：verify 链在 4096 main 栈实测挂死（persistbench
# 实证——教训 31⑤ 同型）；8192 定值。
CONFIG_MAIN_STACK_SIZE=8192
```

## src/main.c
```c
/* SPDX-License-Identifier: Apache-2.0 */
/*
 * psrambench（板级六）：PSRAM 挂接验证（docs/board-psram.md）。
 * 流程：PS1 SMH 探针（读写一致性 + 外部 RAM 地址域证据）→ PS2 通道注册
 * + 链路声明（直启面，framework.app 同款）→ PS3 APP 启动（WAMR 实例堆
 * 此时自 PSRAM 分配——runtime 打印池地址）→ evt 写路径全链 → PASS。
 */
#include <string.h>
#include <zephyr/kernel.h>
#include <zephyr/multi_heap/shared_multi_heap.h>
#include <ts/appmgr.h>
#include <ts/hal.h>
#include <ts/safety.h>
#include "app_wasm.h"

static const ts_out_ch_t ps_ch = {
	.uid = "ps0", .kind = TS_CH_GPIO,
	.poweron = {.b = false}, .linkloss = {.b = false}, .fault = {.b = false},
};
static const ts_hal_dev_desc_t ps_dev = {.uid = "ps0", .kind = TS_DEV_GPIO_OUT};

static bool ps_gpio(void)
{
	ts_out_value_t v;

	if (ts_safety_readback("ps0", &v) != TS_OK) {
		return false;
	}
	return v.b;
}

static bool ps_wait_gpio(bool want)
{
	for (int i = 0; i < 300; i++) {
		if (ps_gpio() == want) {
			return true;
		}
		k_msleep(10);
	}
	return false;
}

int main(void)
{
	printk("PS0 psrambench\n");

	/* PS1: SMH 探针——esp32s3 外部 RAM 映射 0x3c000000 起（内部 SRAM 为
	 * 0x40xx/0x3fc8xx），指针值即位置证据。 */
	uint8_t *probe = shared_multi_heap_alloc(SMH_REG_ATTR_EXTERNAL, 256);

	if (probe == NULL) {
		printk("PS FAIL smh alloc\n");
		return 1;
	}
	for (int i = 0; i < 256; i++) {
		probe[i] = (uint8_t)(0xA5 ^ i);
	}
	bool ok = true;

	for (int i = 0; i < 256; i++) {
		ok = ok && probe[i] == (uint8_t)(0xA5 ^ i);
	}
	printk("PS1 smh probe: buf=%p %s\n", probe,
	       ok ? "读写一致（PSRAM 存活）" : "读写不一致");
	shared_multi_heap_free(probe);
	if (!ok || ((uintptr_t)probe >> 24) != 0x3cU) {
		printk("PS FAIL smh verify (addr domain)\n");
		return 1;
	}

	/* PS2: 通道 + 链路（直启面；无 core_boot/linkmon 干扰） */
	if (ts_hal_register_dev(&ps_dev) != TS_OK ||
	    ts_safety_register_channel(&ps_ch) != TS_OK) {
		printk("PS FAIL channel\n");
		return 1;
	}
	ts_safety_set_link(true);

	/* PS3: APP 启动——WAMR 实例堆经 runtime 自 PSRAM 分配（console 有
	 * "[appmgr] wamr pool heap: buf=0x3c... (psram/smh)" 行 = 位置证据） */
	if (ts_appmgr_app_start(1, app_wasm, app_wasm_len, "gpio:write:0-3") != TS_OK) {
		printk("PS FAIL app_start\n");
		return 1;
	}
	if (!ps_wait_gpio(true)) {
		printk("PS FAIL app_init write\n");
		return 1;
	}
	printk("PS3 app_init -> gpio=1（WAMR 池=PSRAM，全链）\n");
	if (ts_appmgr_app_evt(0) == TS_OK && ps_wait_gpio(false)) {
		printk("PS3 app_evt(0) -> gpio=0\n");
	} else {
		printk("PS FAIL app_evt\n");
		return 1;
	}
	struct ts_app_rt_stats st;

	ts_appmgr_app_stats(&st);
	printk("PS PASS init_res=%d evt_seen=%u heap=%uKB@PSRAM\n",
	       (int)st.init_res, st.evt_seen, CONFIG_TS_APP_WAMR_HEAP / 1024);
	for (;;) {
		k_msleep(5000);
		printk("PS alive t=%u\n", (unsigned)k_uptime_get_32());
	}
}
```

## src/app_wasm.h
```c
/* 生成文件：xxd -i native_app.wasm > ../src/app_wasm.h（native_app.c 变更后重生成并提交）*/
unsigned char app_wasm[] = {
  0x00, 0x61, 0x73, 0x6d, 0x01, 0x00, 0x00, 0x00, 0x01, 0x11, 0x03, 0x60,
  0x03, 0x7f, 0x7f, 0x7f, 0x01, 0x7f, 0x60, 0x01, 0x7f, 0x01, 0x7f, 0x60,
  0x00, 0x01, 0x7f, 0x02, 0x15, 0x01, 0x03, 0x65, 0x6e, 0x76, 0x0d, 0x74,
  0x73, 0x5f, 0x67, 0x70, 0x69, 0x6f, 0x5f, 0x77, 0x72, 0x69, 0x74, 0x65,
  0x00, 0x00, 0x03, 0x06, 0x05, 0x01, 0x01, 0x02, 0x02, 0x02, 0x04, 0x05,
  0x01, 0x70, 0x01, 0x01, 0x01, 0x05, 0x03, 0x01, 0x00, 0x02, 0x06, 0x08,
  0x01, 0x7f, 0x01, 0x41, 0x90, 0x88, 0x04, 0x0b, 0x07, 0x47, 0x06, 0x06,
  0x6d, 0x65, 0x6d, 0x6f, 0x72, 0x79, 0x02, 0x00, 0x08, 0x61, 0x70, 0x70,
  0x5f, 0x69, 0x6e, 0x69, 0x74, 0x00, 0x01, 0x07, 0x61, 0x70, 0x70, 0x5f,
  0x65, 0x76, 0x74, 0x00, 0x02, 0x08, 0x61, 0x70, 0x70, 0x5f, 0x74, 0x69,
  0x63, 0x6b, 0x00, 0x03, 0x0b, 0x68, 0x65, 0x61, 0x6c, 0x74, 0x68, 0x5f,
  0x70, 0x69, 0x6e, 0x67, 0x00, 0x04, 0x0c, 0x67, 0x65, 0x74, 0x5f, 0x6c,
  0x61, 0x73, 0x74, 0x5f, 0x65, 0x76, 0x74, 0x00, 0x05, 0x0a, 0x76, 0x05,
  0x19, 0x00, 0x41, 0x00, 0x20, 0x00, 0x36, 0x02, 0x84, 0x88, 0x80, 0x80,
  0x00, 0x20, 0x00, 0x41, 0x00, 0x41, 0x01, 0x10, 0x80, 0x80, 0x80, 0x80,
  0x00, 0x0b, 0x3d, 0x00, 0x02, 0x40, 0x20, 0x00, 0x41, 0x80, 0x02, 0x71,
  0x45, 0x0d, 0x00, 0x41, 0x00, 0x41, 0x01, 0x36, 0x02, 0x88, 0x88, 0x80,
  0x80, 0x00, 0x41, 0x00, 0x0f, 0x0b, 0x41, 0x00, 0x20, 0x00, 0x36, 0x02,
  0x80, 0x88, 0x80, 0x80, 0x00, 0x41, 0x00, 0x28, 0x02, 0x84, 0x88, 0x80,
  0x80, 0x00, 0x41, 0x00, 0x20, 0x00, 0x41, 0x01, 0x71, 0x10, 0x80, 0x80,
  0x80, 0x80, 0x00, 0x0b, 0x04, 0x00, 0x41, 0x00, 0x0b, 0x0b, 0x00, 0x41,
  0x00, 0x28, 0x02, 0x88, 0x88, 0x80, 0x80, 0x00, 0x0b, 0x0b, 0x00, 0x41,
  0x00, 0x28, 0x02, 0x80, 0x88, 0x80, 0x80, 0x00, 0x0b, 0x0b, 0x0b, 0x01,
  0x00, 0x41, 0x80, 0x08, 0x0b, 0x04, 0xff, 0xff, 0xff, 0xff
};
unsigned int app_wasm_len = 286;
```
