## CMakeLists.txt
```
# SPDX-License-Identifier: Apache-2.0
cmake_minimum_required(VERSION 3.20.0)
find_package(Zephyr REQUIRED HINTS $ENV{ZEPHYR_BASE})
project(tessera_wamr)

target_sources(app PRIVATE src/main.c)
```

## prj.conf
```kconfig
# SPDX-License-Identifier: Apache-2.0
CONFIG_ZTEST=y
CONFIG_TS_APP_WAMR=y
```

## src/main.c
```c
/* SPDX-License-Identifier: Apache-2.0 */
/* framework.wamr（M2b.2a 环境批）：WAMR 装载/实例化/调用冒烟——native_sim 上
 * 验证 DEC-25 执行模式配置（fast 解释器 + WASI 关）真实可跑。
 * 判据：① 零导入面（无导入注册即实例化成功 = WASI 关 + ts_* 导入面为空的
 * 边界证明）；② health_ping/on_input 调用返回确定值（合同 9 友好：纯函数）。
 * 注：Q-23（宿主线程模型）裁定前的构建级/装载级验证——不经 appmgr 接线，
 * 测试线程直调 WAMR API，不引入生产线程语义。 */
#include <string.h>
#include <zephyr/ztest.h>
#include <wasm_export.h>
#include "wasm_bytes.h"

ZTEST(framework_wamr, test_01_load_instantiate_call)
{
	char err[128];
	zassert_true(wasm_runtime_init(), "runtime init");
	wasm_module_t mod = wasm_runtime_load(wasm_bytes, sizeof(wasm_bytes), err, sizeof(err));
	zassert_not_null(mod, "load: %s", err);

	/* 零导入面证明：不注册任何 native 符号直接实例化 */
	wasm_module_inst_t inst = wasm_runtime_instantiate(mod, 4096, 8192, err, sizeof(err));
	zassert_not_null(inst, "instantiate（零导入）: %s", err);

	wasm_exec_env_t env = wasm_runtime_create_exec_env(inst, 4096);
	zassert_not_null(env, "exec env");

	/* health_ping（manifest V1 必选导出）→ 恒 1 */
	wasm_function_inst_t fn = wasm_runtime_lookup_function(inst, "health_ping");
	zassert_not_null(fn, "lookup health_ping");
	uint32_t argv[1] = {0};
	zassert_true(wasm_runtime_call_wasm(env, fn, 0, argv), "call health_ping");
	zassert_equal(argv[0], 1, "health_ping 返回");

	/* on_input（确定性纯函数）：21 → 43 */
	fn = wasm_runtime_lookup_function(inst, "on_input");
	zassert_not_null(fn, "lookup on_input");
	argv[0] = 21;
	zassert_true(wasm_runtime_call_wasm(env, fn, 1, argv), "call on_input");
	zassert_equal(argv[0], 43, "on_input(21) = 43（确定性）");
	/* 同输入重放（合同 9 方向性自检） */
	uint32_t again[1] = {21};
	zassert_true(wasm_runtime_call_wasm(env, fn, 1, again), "call on_input again");
	zassert_equal(again[0], 43, "重放一致");

	wasm_runtime_destroy_exec_env(env);
	wasm_runtime_deinstantiate(inst);
	wasm_runtime_unload(mod);
	wasm_runtime_destroy();
}

ZTEST_SUITE(framework_wamr, NULL, NULL, NULL, NULL, NULL);
```

## src/wasm_bytes.h
```c
/* 生成文件：xxd -i sample.wasm | sed s/sample_wasm/wasm_bytes/ > ../src/wasm_bytes.h（sample.c 变更后重生成并提交）*/
unsigned char wasm_bytes[] = {
  0x00, 0x61, 0x73, 0x6d, 0x01, 0x00, 0x00, 0x00, 0x01, 0x0a, 0x02, 0x60,
  0x00, 0x01, 0x7f, 0x60, 0x01, 0x7f, 0x01, 0x7f, 0x03, 0x03, 0x02, 0x00,
  0x01, 0x04, 0x05, 0x01, 0x70, 0x01, 0x01, 0x01, 0x05, 0x03, 0x01, 0x00,
  0x02, 0x06, 0x08, 0x01, 0x7f, 0x01, 0x41, 0x80, 0x88, 0x04, 0x0b, 0x07,
  0x23, 0x03, 0x06, 0x6d, 0x65, 0x6d, 0x6f, 0x72, 0x79, 0x02, 0x00, 0x0b,
  0x68, 0x65, 0x61, 0x6c, 0x74, 0x68, 0x5f, 0x70, 0x69, 0x6e, 0x67, 0x00,
  0x00, 0x08, 0x6f, 0x6e, 0x5f, 0x69, 0x6e, 0x70, 0x75, 0x74, 0x00, 0x01,
  0x0a, 0x11, 0x02, 0x04, 0x00, 0x41, 0x01, 0x0b, 0x0a, 0x00, 0x20, 0x00,
  0x41, 0x01, 0x74, 0x41, 0x01, 0x72, 0x0b
};
unsigned int wasm_bytes_len = 103;
```
