## firmware/boards/osptek/esp32p4c5_core_board/Kconfig
```kconfig
# Copyright (c) 2026 Tessera Project
#
# SPDX-License-Identifier: Apache-2.0

config HEAP_MEM_POOL_ADD_SIZE_BOARD
	int
	default 4096 if BOARD_ESP32P4C5_CORE_BOARD_ESP32P4_HPCORE
	default 256 if BOARD_ESP32P4C5_CORE_BOARD_ESP32P4_LPCORE
```

## firmware/boards/osptek/esp32p4c5_core_board/Kconfig.defconfig
```kconfig
# Copyright (c) 2026 Tessera Project
#
# SPDX-License-Identifier: Apache-2.0

if BOARD_ESP32P4C5_CORE_BOARD_ESP32P4_HPCORE

configdefault MAIN_STACK_SIZE
	default 4096

endif # BOARD_ESP32P4C5_CORE_BOARD_ESP32P4_HPCORE
```

## firmware/boards/osptek/esp32p4c5_core_board/Kconfig.esp32p4c5_core_board
```kconfig
# Osptek ESP32-P4C5 Core Board configuration
#
# Copyright (c) 2026 Tessera Project
#
# SPDX-License-Identifier: Apache-2.0

config BOARD_ESP32P4C5_CORE_BOARD
	select SOC_ESP32P4_HPCORE if BOARD_ESP32P4C5_CORE_BOARD_ESP32P4_HPCORE
	select SOC_ESP32P4_LPCORE if BOARD_ESP32P4C5_CORE_BOARD_ESP32P4_LPCORE
	select SOC_ESP32P4_REV_3_1
```

## firmware/boards/osptek/esp32p4c5_core_board/board.yml
```yaml
board:
  name: esp32p4c5_core_board
  full_name: Osptek ESP32-P4C5 Core Board
  vendor: osptek
  socs:
  - name: esp32p4
```

## firmware/tests/app/testcase.yaml
```yaml
tests:
  framework.app:
    tags: framework
    integration_platforms:
      - native_sim
    # APP 运行时宿主端到端（WAMR 源根经 TS_WAMR_DIR 注入）。
    platform_allow:
      - native_sim
```

## firmware/tests/appmgr/testcase.yaml
```yaml
tests:
  framework.appmgr:
    tags: framework
    integration_platforms:
      - native_sim
    platform_allow:
      - native_sim
```

## firmware/tests/hal/testcase.yaml
```yaml
tests:
  framework.hal:
    tags: framework
    integration_platforms:
      - native_sim
    platform_allow:
      - native_sim
```

## firmware/tests/interact/testcase.yaml
```yaml
tests:
  framework.interact.default:
    platform_allow:
      - native_sim
      - native_sim/native/64
    tags: interact
    harness: console
    harness_config:
      type: multi_line
      regex:
        - "INTERACT DONE"
```

## firmware/tests/store/testcase.yaml
```yaml
tests:
  framework.store:
    tags: framework
    integration_platforms:
      - native_sim
    platform_allow:
      - native_sim
      - native_sim/native/64
  framework.store.flash:
    tags: framework
    integration_platforms:
      - native_sim
    platform_allow:
      - native_sim
      - native_sim/native/64
    extra_args: DTC_OVERLAY_FILE=flash.overlay EXTRA_CONF_FILE=flash.conf
```

## firmware/tests/wamr/testcase.yaml
```yaml
tests:
  framework.wamr:
    tags: framework
    integration_platforms:
      - native_sim
    # WAMR 接入批仅在 native_sim（源根经 TS_WAMR_DIR 注入；板级目标随移植批映射）。
    platform_allow:
      - native_sim
```
